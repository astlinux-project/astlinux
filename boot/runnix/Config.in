## boot/runnix/Config.in
```kconfig
config BR2_TARGET_RUNNIX
	bool "runnix"
	default y
	depends on BR2_i386 || BR2_x86_64
	help
	  The runnix bootloader for x86 systems

	  http://www.astlinux-project.org
```

## boot/syslinux/Config.in
```kconfig
config BR2_TARGET_SYSLINUX
	bool "syslinux"
	depends on BR2_i386 || BR2_x86_64
	select BR2_PACKAGE_UTIL_LINUX
	select BR2_PACKAGE_UTIL_LINUX_LIBUUID
	help
	  The syslinux bootloader for x86 systems.
	  This includes: syslinux, pxelinux, extlinux.

	  http://syslinux.org

if BR2_TARGET_SYSLINUX

config BR2_TARGET_SYSLINUX_LEGACY_BIOS
	bool "generate bios"
	help
	  Build the 'bios' target, to boot from a Legacy BIOS environment.

config BR2_TARGET_SYSLINUX_EFI
	bool "generate efi64"
	select BR2_PACKAGE_GNU_EFI
	help
	  Build the 'efi64' target, to boot from an EFI environment.

config BR2_TARGET_SYSLINUX_ISOLINUX
	bool "install isolinux"
	help
	  Install the legacy-BIOS 'isolinux' image, to boot off
	  optical media (CDROM, DVD.)

config BR2_TARGET_SYSLINUX_PXELINUX
	bool "install pxelinux"
	help
	  Install the legacy-BIOS 'pxelinux' image, to boot off
	  the network using PXE.

endif
```

## package/acme/Config.in
```kconfig
config BR2_PACKAGE_ACME
	bool "acme"
	depends on BR2_PACKAGE_OPENSSL
	help
	  An ACME (Automated Certificate Management Environment) protocol client
	  Managed using the "acme-client" command.

	  https://github.com/Neilpang/acme.sh
```

## package/apcupsd/Config.in
```kconfig
config BR2_PACKAGE_APCUPSD
	bool "apcupsd"
	default n
	select BR2_PACKAGE_LIBUSB
	help
	    apcupsd is a daemon for controlling APC ups'
	    http://www.apcupsd.org/
```

## package/arnofw/Config.in
```kconfig
config BR2_PACKAGE_ARNOFW
	bool "Arno's Firewall Support"
	default n
	help
	  Arno's IPtables Firewall is a complete Firewall script.	

	  Customized by the AstLinux Project

	  Original: https://github.com/arno-iptables-firewall/aif/
	            https://rocky.eld.leidenuniv.nl/
```

## package/arp-scan/Config.in
```kconfig
config BR2_PACKAGE_ARP_SCAN
	bool "arp-scan"
	default n
	select BR2_PACKAGE_LIBPCAP
	# mac2vendor is only a runtime dependency
	select BR2_PACKAGE_MAC2VENDOR
	help
	  The ARP scanner

	  https://github.com/royhills/arp-scan/

	  http://linux.die.net/man/1/arp-scan
```

## package/asterisk-agi-audiotx/Config.in
```kconfig
config BR2_PACKAGE_ASTERISK-AGI-AUDIOTX
	bool "asterisk-agi-audiotx"
	default n
	depends on BR2_PACKAGE_ASTERISK && BR2_PACKAGE_ASTERISK_v1_4
	help
	  AGI Audio File Transfer Addons for Asterisk.

	  http://agi-audiotx.sourceforge.net/
```

## package/asterisk-app_notify/Config.in
```kconfig
config BR2_PACKAGE_ASTERISK_APP_NOTIFY
        bool "asterisk-app_notify"
        default n
        depends on BR2_PACKAGE_ASTERISK
        help
                Network Notification Application Module for Asterisk

                http://www.mezzo.net/asterisk/app_notify.html

		**Deprecated in AstLinux** Instead, use the the code link below (AstLinux 1.0.2 and later):

		Example Asterisk Dialplan snippet:

		http://doc.astlinux.org/userdoc:tt_asterisk_call_notify
```

## package/asterisk-app_nvfax/Config.in
```kconfig
config BR2_PACKAGE_ASTERISK_APP_NVFAX
	bool "asterisk-app_nvfax"
	default n
	depends on BR2_PACKAGE_ASTERISK && BR2_PACKAGE_ASTERISK_v1_4
	help
	  Detect fax tone on incoming calls.
```

## package/asterisk-app_waituntil/Config.in
```kconfig
config BR2_PACKAGE_ASTERISK_APP_WAITUNTIL
	bool "asterisk-app_waituntil"
	default n
	depends on BR2_PACKAGE_ASTERISK && BR2_PACKAGE_ASTERISK_v1_4
	help
	  Simple app that enables time-of-day robot service, etc.

	  See:
	    http://bugs.digium.com/view.php?id=11487
```

## package/asterisk-codec-silk/Config.in
```kconfig
config BR2_PACKAGE_ASTERISK_CODEC_SILK
	bool "asterisk-codec-silk"
	default n
	depends on BR2_PACKAGE_ASTERISK && ( ! BR2_PACKAGE_ASTERISK_v1_8 )
	help
	  SILK CODEC developed by Skype (owned by Microsoft)
	  License supplied by Digium in x86 binary form.

	  https://developer.skype.com/resources/SILKDataSheet.pdf
	  http://en.wikipedia.org/wiki/SILK
```

## package/asterisk-fop2/Config.in
```kconfig
config BR2_PACKAGE_ASTERISK_FOP2
	bool "asterisk-fop2"
	depends on BR2_PACKAGE_ASTERISK
	default n
	help
	  Asterisk Operator Panel 2
	  Free version for up to 15 buttons.

	  Note: Only the supporting framework is included on the AstLinux image,
	        use the CLI command...
	          "upgrade-package fop2 upgrade"
	        to install 'fop2' at runtime.

	  http://www.fop2.com/
```

## package/asterisk-func_devstate/Config.in
```kconfig
config BR2_PACKAGE_ASTERISK_FUNC_DEVSTATE
	bool "asterisk-func_devstate"
	default n
	depends on BR2_PACKAGE_ASTERISK && BR2_PACKAGE_ASTERISK_v1_4
	help
	  Backport of func_devstate from Asterisk 1.6

	  See:
	   http://www.asterisk.org/node/48360
```

## package/asterisk-func_extstate/Config.in
```kconfig
config BR2_PACKAGE_ASTERISK_FUNC_EXTSTATE
	bool "asterisk-func_extstate"
	default n
	depends on BR2_PACKAGE_ASTERISK && BR2_PACKAGE_ASTERISK_v1_4
	help
	  Backport of func_extstate from Asterisk 1.6

	  See:
           https://issues.asterisk.org/view.php?id=10635
```

## package/asterisk-gui/Config.in
```kconfig
config BR2_PACKAGE_ASTERISK_GUI
	bool "asterisk-gui"
	default n
	depends on BR2_PACKAGE_ASTERISK
	help
	  The GUI for Asterisk from Digium.

	  http://www.asterisk.org/
```

## package/asterisk/Config.in
```kconfig
config BR2_PACKAGE_ASTERISK
	bool "asterisk"
	default n
	select BR2_PACKAGE_NCURSES
	select BR2_PACKAGE_ZLIB
	select BR2_PACKAGE_OPENSSL
	select BR2_PACKAGE_LIBTOOL
	select BR2_PACKAGE_UTIL_LINUX
	select BR2_PACKAGE_SQLITE
	help
		Asterisk - the Open Source PBX

choice
	prompt "Asterisk Version"
	depends on BR2_PACKAGE_ASTERISK
	default BR2_PACKAGE_ASTERISK_v20
	help
		Select which version of Asterisk to compile and install.

	config BR2_PACKAGE_ASTERISK_v18se
		bool "Asterisk v18.x SE"
		help
			Asterisk LTS Series, Stable Edition

	config BR2_PACKAGE_ASTERISK_v20
		bool "Asterisk v20.x"
		help
			Asterisk LTS Series, Latest Version
endchoice

comment "cdr_mysql, app_mysql and res_config_mysql - disabled (requires MYSQL_CLIENT)"
        depends on !BR2_PACKAGE_MYSQL_CLIENT && BR2_PACKAGE_ASTERISK
comment "cdr_mysql, app_mysql and res_config_mysql - enabled"
        depends on BR2_PACKAGE_MYSQL_CLIENT && BR2_PACKAGE_ASTERISK

comment "app_voicemail=IMAP_STORAGE - disabled (requires UW_IMAP)"
        depends on !BR2_PACKAGE_UW_IMAP && BR2_PACKAGE_ASTERISK
comment "app_voicemail=IMAP_STORAGE - enabled"
        depends on BR2_PACKAGE_UW_IMAP && BR2_PACKAGE_ASTERISK

config BR2_PACKAGE_ASTERISK_MENUSELECT
	bool "Asterisk custom configure"
	default n
	depends on BR2_PACKAGE_ASTERISK
	help
	  Run interactive menuselect to select custom Asterisk options
```

## package/bash/Config.in
```kconfig
config BR2_PACKAGE_BASH
	bool "bash"
	select BR2_PACKAGE_NCURSES
	help
	  The standard GNU Bourne again shell.

	  http://tiswww.case.edu/php/chet/bash/bashtop.html

if BR2_PACKAGE_BASH

config BR2_PACKAGE_BASH_DEFAULT_SHELL
	bool "bash default shell"
	default y
	help
	  Link /bin/sh to bash

endif
```

## package/bc/Config.in
```kconfig
config BR2_PACKAGE_BC
	bool "bc"
	default n
	help
	  BC - The GNU bc arbitrary precision calculator language  

	  http://ftp.gnu.org/gnu/bc
```

## package/bfdetect/Config.in
```kconfig
config BR2_PACKAGE_BFDETECT
	bool "bfdetect"
	default n

	help
	  Simple app that detects a Beronet Berofix card

	  http://wiki.beronet.com/index.php/Download
```

## package/busybox/Config.in
```kconfig
config BR2_PACKAGE_BUSYBOX
	bool "BusyBox"
	default y
	help
	  The Swiss Army Knife of embedded Linux. It slices, it dices,
	  it makes Julian Fries.

	  https://busybox.net/

	  Most people will answer Y.

if BR2_PACKAGE_BUSYBOX

config BR2_PACKAGE_BUSYBOX_CONFIG
	string "BusyBox configuration file to use?"
	default "package/busybox/busybox.config"
	help
	  Some people may wish to use their own modified BusyBox configuration
	  file, and will specify their config file location with this option.

# This option is not an option of Busybox, it can be selected even
# if Busybox is not enabled.
config BR2_PACKAGE_BUSYBOX_SHOW_OTHERS
	bool "Show packages that are also provided by busybox"
	help
	  Show packages in menuconfig that are potentially also provided
	  by busybox.

endif

if !BR2_PACKAGE_BUSYBOX # kconfig doesn't support else

comment "You may need to enable other packages to get a working system"
comment "You better know what you're doing!"

# This option is not an option of Busybox, it can be selected even if
# Busybox is not enabled. This dummy option ensures that packages that
# depend on BR2_PACKAGE_BUSYBOX_SHOW_OTHERS are visible when Busybox
# is disabled.
config BR2_PACKAGE_BUSYBOX_SHOW_OTHERS
       default y
endif
```

## package/ca-certificates/Config.in
```kconfig
config BR2_PACKAGE_CA_CERTIFICATES
	bool "CA Certificates"
	depends on BR2_PACKAGE_OPENSSL
	help
	  This package includes PEM files of CA certificates to allow
	  SSL-based applications to check for the authenticity of SSL
	  connections.

	  https://curl.haxx.se/docs/caextract.html
```

## package/chrony/Config.in
```kconfig
config BR2_PACKAGE_CHRONY
	bool "chrony"
	select BR2_PACKAGE_LIBCAP
	help
	  An NTP client and server designed to perform well in a wide range
	  of conditions. It can synchronize the system clock with NTP servers,
	  reference clocks, and manual input using wristwatch and keyboard.

	  https://chrony-project.org/
```

## package/clix/Config.in
```kconfig
config BR2_PACKAGE_CLIX
	bool "clix"
	select BR2_PACKAGE_OPENSSL
	select BR2_PACKAGE_LIBIDN
	select BR2_PACKAGE_LUA
	select BR2_PACKAGE_LUAFILESYSTEM
	select BR2_PACKAGE_LUASOCKET
	select BR2_PACKAGE_LUASEC
	select BR2_PACKAGE_LUAEXPAT
	default n
	help
	  clix is a command line client for Jabber/XMPP written in Lua

	  hg clone http://code.matthewwild.co.uk/verse
	  hg clone http://code.matthewwild.co.uk/clix
	  hg clone http://code.matthewwild.co.uk/squish

	  Manually created into package download.
```

## package/dahdi-linux/Config.in
```kconfig
config BR2_PACKAGE_DAHDI_LINUX
	bool "dahdi-linux"
	default n
	depends on BR2_LINUX_KERNEL
	select BR2_PACKAGE_LIBUSB
	select BR2_PACKAGE_LIBUSB_COMPAT
	help
		Dahdi - Linux drivers and utilities for Digium cards
		for use with Asterisk:

		http://www.asterisk.org

config BR2_PACKAGE_DAHDI_OSLEC
	bool "dahdi_echocan_oslec"
	default n
	depends on BR2_PACKAGE_DAHDI_LINUX
	help
		Adds modules "echo" and "dahdi_echocan_oslec"

		http://www.rowetel.com/blog/?page_id=454

config BR2_PACKAGE_DAHDI_NO_CARD_FIRMWARE
	bool "dahdi_no_card_firmware"
	default n
	depends on BR2_PACKAGE_DAHDI_LINUX
	help
		Reduce image size by removing PCI / PCI-e card firmware files.

		It saves 8.8 MB (DAHDI 2.10) of uncompressed space.
```

## package/dahdi-tools/Config.in
```kconfig
config BR2_PACKAGE_DAHDI_TOOLS
	bool "dahdi-tools"
	default n
	depends on BR2_LINUX_KERNEL
	select BR2_PACKAGE_DAHDI_LINUX
	select BR2_PACKAGE_LIBUSB
	select BR2_PACKAGE_LIBUSB_COMPAT
	select BR2_PACKAGE_NEWT
	help
		Dahdi - Linux utilities for Digium cards
		for use with Asterisk:

		http://www.asterisk.org
```
