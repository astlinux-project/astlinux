## package/prosody/Config.in
```kconfig
config BR2_PACKAGE_PROSODY
	bool "prosody"
	select BR2_PACKAGE_OPENSSL
	select BR2_PACKAGE_LIBIDN
	select BR2_PACKAGE_LUA
	select BR2_PACKAGE_LUABITOP
	select BR2_PACKAGE_LUAFILESYSTEM
	select BR2_PACKAGE_LUASOCKET
	select BR2_PACKAGE_LUASEC
	select BR2_PACKAGE_LUAEXPAT
	default n
	help
	  Prosody is a modern flexible communications server for Jabber/XMPP written in Lua

	  http://prosody.im/
```

## package/qemu-guest-agent/Config.in
```kconfig
config BR2_PACKAGE_QEMU_GUEST_AGENT
	bool "qemu-guest-agent"
	depends on BR2_TOOLCHAIN_HAS_THREADS # libglib2
	depends on BR2_USE_WCHAR # gettext, libglib2
	depends on BR2_USE_MMU # fork(), libglib2
	select BR2_PACKAGE_LIBGLIB2
	select BR2_PACKAGE_ZLIB
	select BR2_PACKAGE_UTIL_LINUX
	select BR2_PACKAGE_UTIL_LINUX_LIBUUID
	help
	  Implement support for QMP commands and events that terminate and originate
	  respectively within the guest using an agent built as part of QEMU.

	  https://www.qemu.org/
	  https://wiki.qemu.org/Features/GuestAgent

	  Required Kernel Config:
	    CONFIG_VIRTIO_CONSOLE=m
```

## package/qemu/Config.in
```kconfig
comment "QEMU requires a toolchain with wchar, threads"
	depends on BR2_USE_MMU
	depends on !(BR2_TOOLCHAIN_HAS_THREADS && BR2_USE_WCHAR)

config BR2_PACKAGE_QEMU
	bool "QEMU"
	depends on BR2_TOOLCHAIN_HAS_THREADS
	depends on BR2_USE_WCHAR # gettext
	depends on BR2_USE_MMU # fork()
	select BR2_PACKAGE_LIBGLIB2
	select BR2_PACKAGE_PIXMAN
	select BR2_PACKAGE_ZLIB
	select BR2_PACKAGE_UTIL_LINUX
	select BR2_PACKAGE_UTIL_LINUX_LIBUUID
	help
	  QEMU is a generic and open source machine emulator and virtualizer.

	  When used as a machine emulator, QEMU can run OSes and programs made
	  for one machine (e.g. an ARM board) on a different machine (e.g.
	  your own PC). By using dynamic translation, it achieves very good
	  performance.

	  When used as a virtualizer, QEMU achieves near native performances
	  by executing the guest code directly on the host CPU. QEMU supports
	  virtualization when executing under the Xen hypervisor or using the
	  KVM kernel module in Linux. When using KVM, QEMU can virtualize x86,
	  server and embedded PowerPC, and S390 guests.

	  http://qemu.org/

	  Required Kernel Config:
	    CONFIG_VIRTUALIZATION=y
	    CONFIG_KVM=m
	    CONFIG_KVM_INTEL=m
	    CONFIG_KVM_AMD=m
	    CONFIG_VHOST_NET=m

	  Optional Kernel Config (virtio-net DHCP Checksum issue):
	    CONFIG_NETFILTER_XT_TARGET_CHECKSUM=m


if BR2_PACKAGE_QEMU

comment "QEMU Emulators selection"

config BR2_PACKAGE_QEMU_CUSTOM_TARGETS
	string "Enable specific targets"
	default "x86_64-softmmu"
	help
	  Enter here the list of QEMU targets you want to build. For example:

	    System emulation      | User-land emulation
	    ----------------------+-----------------------
	    i386-softmmu          | i386-linux-user
	    arm-softmmu           | ppc-linux-user
	    x86_64-softmmu        | sparc-bsd-user
	    ...                   | ...

config QEMU_FOO
	bool # To break the indentation

if BR2_PACKAGE_QEMU_CUSTOM_TARGETS = ""

comment "... or you can select emulator families to enable, below:"

config BR2_PACKAGE_QEMU_SYSTEM
	bool "Enable all systems emulation"
	help
	  Say 'y' to build all system emulators/virtualisers that QEMU supports.

config BR2_PACKAGE_QEMU_LINUX_USER
	bool "Enable all Linux user-land emulation"
	help
	  Say 'y' to build all Linux user-land emulators that QEMU supports.

# Note: bsd-user can not be build on Linux

endif # BR2_PACKAGE_QEMU_CUSTOM_TARGETS == ""

config BR2_PACKAGE_QEMU_HAS_EMULS
	def_bool y
	depends on BR2_PACKAGE_QEMU_SYSTEM || BR2_PACKAGE_QEMU_LINUX_USER || BR2_PACKAGE_QEMU_CUSTOM_TARGETS != ""

if BR2_PACKAGE_QEMU_HAS_EMULS

comment "QEMU Frontends"

config BR2_PACKAGE_QEMU_SDL
	bool "Enable SDL frontend"
	select BR2_PACKAGE_SDL
	help
	  Say 'y' to enable the SDL frontend, that is, a graphical window
	  presenting the VM's display.

endif # BR2_PACKAGE_QEMU_HAS_EMULS

comment "QEMU System Options"

config BR2_PACKAGE_QEMU_SYSTEM_TOOLS
	bool "Enable system tools"
	help
	  Say 'y' to build qemu-img, qemu-nbd and qemu-io tools.

config BR2_PACKAGE_QEMU_SYSTEM_VNC
	bool "Enable system VNC"
	default y
	help
	  Say 'y' to build VNC display.

endif # BR2_PACKAGE_QEMU
```

## package/r8125/Config.in
```kconfig
config BR2_PACKAGE_R8125
	bool "r8125"
	depends on BR2_LINUX_KERNEL
	default n
	help
	  Linux device driver released for Realtek RTL8125
	  2.5-Gigabit Ethernet controllers with PCI-Express interface.

	  Unix (Linux) 2.5G Ethernet LINUX driver r8125 ...
	  https://www.realtek.com/Download/List?cate_id=584

	  https://github.com/awesometic/realtek-r8125-dkms/releases
```

## package/r8168/Config.in
```kconfig
config BR2_PACKAGE_R8168
	bool "r8168"
	depends on BR2_DEPRECATED
	depends on BR2_LINUX_KERNEL
	default n
	help
	  Linux NIC device driver r8168 released for RealTek RTL8168B/8111B,
	  RTL8168C/8111C, RTL8168CP/8111CP, RTL8168D/8111D, RTL8168DP/8111DP,
	  and RTL8168E/8111E

	  Gigabit Ethernet controllers with PCI-Express interface.

	  http://www.realtek.com.tw/downloads/
```

## package/radvd/Config.in
```kconfig
config BR2_PACKAGE_RADVD
	bool "radvd"
	select BR2_PACKAGE_FLEX
	depends on BR2_INET_IPV6
	depends on !BR2_PACKAGE_DNSMASQ
	help
	  IPv6 Router Advertisement Daemon.

	  http://www.litech.org/radvd/
```

## package/rhino/Config.in
```kconfig
config BR2_PACKAGE_RHINO
	bool "rhino"
	depends on BR2_DEPRECATED
	depends on BR2_LINUX_KERNEL
	select BR2_PACKAGE_DAHDI_LINUX
	default n
	help
		Rhino - Support for Rhino analog and digital PCI cards
		http://www.rhinoequipment.com
```

## package/rng-tools/Config.in
```kconfig
config BR2_PACKAGE_RNG_TOOLS
	bool "rng-tools"
	depends on !BR2_PACKAGE_JITTERENTROPY_RNGD
	select BR2_PACKAGE_LIBSYSFS
	help
	  Daemon to use hardware random number generators.

	  https://github.com/nhorman/rng-tools
```

## package/rtpproxy/Config.in
```kconfig
config BR2_PACKAGE_RTPPROXY
	bool "rtpproxy"
	default n
	help
	  RTPProxy enables VoIP traverse NAT firewalls,
	  Relaying of voice, video or any RTP stream of data.

	  http://www.rtpproxy.org/
```

## package/s3fs/Config.in
```kconfig
config BR2_PACKAGE_S3FS
	bool "s3fs (FUSE)"
	depends on BR2_PACKAGE_LIBFUSE
	select BR2_PACKAGE_LIBCURL
	select BR2_PACKAGE_LIBXML2
	select BR2_PACKAGE_OPENSSL
	help
	  s3fs allows a user to mount an S3 bucket via FUSE (Filesystem in Userspace).
	  s3fs makes you operate files and directories in S3 bucket like a local file system.
	  s3fs preserves the native object format for files.

	  s3fs is stable and is being used in a number of production environments, e.g., rsync backup to s3.

	  https://github.com/s3fs-fuse/s3fs-fuse
```

## package/sipgrep/Config.in
```kconfig
config BR2_PACKAGE_SIPGREP
	bool "sipgrep"
	default n
	select BR2_PACKAGE_LIBPCAP
	select BR2_PACKAGE_PCRE2
	help
	  Network grep for SIP.

	  https://github.com/sipcapture/sipgrep
```

## package/sipp/Config.in
```kconfig
config BR2_PACKAGE_SIPP
	bool "sipp"
	select BR2_PACKAGE_LIBPCAP
	select BR2_PACKAGE_NCURSES
	select BR2_PACKAGE_OPENSSL
	default n
	help

	  SIPp - a SIP protocol testing tool

	  https://github.com/SIPp/sipp
```

## package/sipsak/Config.in
```kconfig
config BR2_PACKAGE_SIPSAK
	bool "sipsak"
	select BR2_PACKAGE_OPENSSL
	default n
	help
	  sipsak is a small command line tool for developers and administrators of Session Initiation Protocol (SIP) applications. 
 	  It can be used for some simple tests on SIP applications and devices.

	  http://sourceforge.net/projects/sipsak.berlios/
	  http://linux.die.net/man/1/sipsak
	  https://github.com/sipwise/sipsak
```

## package/spandsp/Config.in
```kconfig
config BR2_PACKAGE_SPANDSP
	bool "spandsp"
	default n
	select BR2_PACKAGE_TIFF
	help
	  spandsp - spandsp library and rxfax/txfax for Asterisk  

	  http://www.soft-switch.org/downloads/snapshots/spandsp/spandsp-20061116.tar.gz
```

## package/sqliteodbc/Config.in
```kconfig
config BR2_PACKAGE_SQLITEODBC
	bool "sqliteodbc"
	default n
	depends on BR2_PACKAGE_SQLITE
	select BR2_PACKAGE_UNIXODBC
	select BR2_PACKAGE_LIBXML2
	help

	  SQLite library wrapped into an ODBC driver.

	  http://www.ch-werner.de/sqliteodbc/
```

## package/strongswan/Config.in
```kconfig
menuconfig BR2_PACKAGE_STRONGSWAN
	bool "strongswan"
	select BR2_PACKAGE_OPENSSL
	help
	  strongSwan is an OpenSource IPsec implementation for the
	  Linux operating system. It is based on the discontinued
	  FreeS/WAN project and the X.509 patch.

	  The focus is on:
	     - simplicity of configuration
	     - strong encryption and authentication methods
	     - powerful IPsec policies supporting large and complex VPN networks

	  strongSwan provide many plugins. Only a few are presented here.

	  https://www.strongswan.org/

if BR2_PACKAGE_STRONGSWAN

config BR2_PACKAGE_STRONGSWAN_AF_ALG
	bool "Enable AF_ALG crypto interface to Linux Crypto API"

config BR2_PACKAGE_STRONGSWAN_CHARON
	bool "Enable the IKEv1/IKEv2 keying daemon charon"
	default y

if BR2_PACKAGE_STRONGSWAN_CHARON

config BR2_PACKAGE_STRONGSWAN_EAP
	bool "Enable EAP protocols"
	default y
	help
	  Enable various EAP protocols:
	    - mschapv2
	    - tls
	    - ttls
	    - peap
	    - identity
	    - md5

config BR2_PACKAGE_STRONGSWAN_SQLITE
	bool "Enable SQLite database support"
	depends on BR2_PACKAGE_SQLITE

config BR2_PACKAGE_STRONGSWAN_VICI
	bool "Enable vici/swanctl"
	default y

endif

endif
```

## package/system-vendor/Config.in
```kconfig
config BR2_PACKAGE_SYSTEM_VENDOR
	bool "system-vendor"
	default n
	help
	  A shell script and text database file used to fingerprint
	  system vendor hardware, and generate an informative model name.

	  Lonnie Abelbeck
	  https://www.astlinux-project.org/
```

## package/tarsnap/Config.in
```kconfig
config BR2_PACKAGE_TARSNAP
	bool "tarsnap"
	select BR2_PACKAGE_OPENSSL
	select BR2_PACKAGE_ZLIB
	select BR2_PACKAGE_E2FSPROGS
	help
	  "Online backups for the truly paranoid"
	  Tarsnap is a secure, efficient online backup service:
	  o Encryption: your data can only be accessed with your personal keys.
	  o Source code: the client code is available.
	  o Deduplication: only the unique data between your current files
	    and encrypted archives is uploaded.

	  https://www.tarsnap.com
	  https://github.com/Tarsnap/tarsnap
```

## package/tg3/Config.in
```kconfig
config BR2_PACKAGE_TG3
	bool "tg3"
	depends on BR2_DEPRECATED
	depends on BR2_LINUX_KERNEL
	default n
	help
	  Linux NIC device driver tg3 released for Broadcom's NetLink Ethernet
	  controllers: 5784, 5785, 57780, 57781, 57785, 57790, 57795

	  10/100/1000 Mbps PCI/PCI-X/PCI Express Ethernet Network Controllers

	  http://www.broadcom.com/support/ethernet_nic/netlink_k57.php
```

## package/tinyproxy/Config.in
```kconfig
config BR2_PACKAGE_TINYPROXY
	bool "tinyproxy"
 	default n
	help
	  Tinyproxy is a small, efficient HTTP/SSL proxy daemon released
	  under the GNU General Public License. Tinyproxy is very
	  useful in a small network setting, where a larger proxy would
	  be too resource intensive.

	  https://tinyproxy.github.io
```

## package/udev/Config.in
```kconfig
config BR2_PACKAGE_UDEV
	bool "udev"
	depends on BR2_ROOTFS_DEVICE_CREATION_DYNAMIC_UDEV
	depends on BR2_USE_MMU # uses fork()
	depends on BR2_USE_WCHAR # needs C99 compiler
	select BR2_PACKAGE_UTIL_LINUX
	select BR2_PACKAGE_UTIL_LINUX_LIBBLKID
	select BR2_PACKAGE_KMOD
	help
	  eudev is a fork of systemd-udev with the goal of obtaining
	  better compatibility with existing software such as OpenRC and
	  Upstart, older kernels, various toolchains and anything else
	  required by users and various distributions.

	  https://github.com/eudev-project/eudev

comment "udev requires /dev mgmnt set to udev under System configuration"
	depends on !BR2_ROOTFS_DEVICE_CREATION_DYNAMIC_UDEV
```

## package/unbound/Config.in
```kconfig
config BR2_PACKAGE_UNBOUND
	bool "unbound, unbound lib and unbound-host tool"
	select BR2_PACKAGE_OPENSSL
	select BR2_PACKAGE_EXPAT
	help
	  Unbound is a validating, recursive, and caching DNS resolver.

	  https://www.unbound.net
```

## package/unionfs/Config.in
```kconfig
config BR2_PACKAGE_UNIONFS
	bool "unionfs (FUSE)"
	depends on BR2_TOOLCHAIN_HAS_THREADS # libfuse
	depends on BR2_USE_MMU # libfuse
	select BR2_PACKAGE_LIBFUSE
	help
	  A userspace unionfs implementation.

	  https://github.com/rpodgorny/unionfs-fuse
```

## package/unixodbc/Config.in
```kconfig
config BR2_PACKAGE_UNIXODBC
	bool "unixodbc"
	default n
	select BR2_PACKAGE_LIBTOOL
	help

	  Connect to ODBC resources from Linux systems

	  https://www.unixodbc.org
```

## package/usbutils/Config.in
```kconfig
config BR2_PACKAGE_USBUTILS
	bool "usbutils"
	select BR2_PACKAGE_LIBUSB
	help
	  USB enumeration utilities

	  https://sourceforge.net/projects/linux-usb/
```
