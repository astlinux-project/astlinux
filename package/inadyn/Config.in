## package/inadyn/Config.in
```kconfig
config BR2_PACKAGE_INADYN
	depends on !BR2_PACKAGE_DDCLIENT
	bool "inadyn"
	default n
	help
		inadyn - Dynamic DNS client that supports many services


		http://www.inatech.eu/inadyn
```

## package/iperf3/Config.in
```kconfig
config BR2_PACKAGE_IPERF3
	bool "iperf3"
	help
	  iperf is a tool for active measurements of the maximum
	  achievable bandwidth on IP networks.
	  It supports tuning of various parameters related to timing,
	  protocols, and buffers. For each test it reports the bandwidth,
	  loss, and other parameters.
	  It's a redesign of the NLANR/DAST iperf(2) and is not
	  backward compatible.

	  https://software.es.net/iperf/
	  https://github.com/esnet/iperf
```

## package/iprange/Config.in
```kconfig
config BR2_PACKAGE_IPRANGE
	bool "iprange"
	help
	  iprange is a tool capable of managing sets of IPs.

	  https://github.com/firehol/iprange/wiki
```

## package/jitterentropy-rngd/Config.in
```kconfig
config BR2_PACKAGE_JITTERENTROPY_RNGD
	bool "jitterentropy-rngd"
	depends on BR2_USE_MMU # uses fork()
	help
	  Using the Jitter RNG core, the rngd provides an entropy source that
	  feeds into the Linux /dev/random device if its entropy runs low.
	  It updates the /dev/random entropy estimator.

	  https://github.com/smuellerDD/jitterentropy-rngd

	  https://github.com/smuellerDD/jitterentropy-rngd/issues/27
```

## package/kamailio/Config.in
```kconfig
config BR2_PACKAGE_KAMAILIO
	bool "kamailio"
	default n
	select BR2_PACKAGE_OPENSSL
	# rtpproxy is only a runtime dependency
	select BR2_PACKAGE_RTPPROXY
	help
	  Kamailio (formerly OpenSER) is an Open Source, rock solid, SIP Server

	  http://www.kamailio.org/
```

## package/keepalived/Config.in
```kconfig
config BR2_PACKAGE_KEEPALIVED
	bool "keepalived"
	depends on BR2_USE_MMU
	depends on BR2_LINUX_KERNEL
	select BR2_PACKAGE_OPENSSL
	help
	  The main goal of this project is to provide simple and robust
	  facilities for loadbalancing and high-availability to Linux
	  system and Linux based infrastructures. Loadbalancing framework
	  relies on well-known and widely used Linux Virtual Server (IPVS)
	  kernel module providing Layer4 loadbalancing. Keepalived
	  implements a set of checkers to dynamically and adaptively
	  maintain and manage loadbalanced server pool according their health.

	  http://www.keepalived.org/
```

## package/kmod/Config.in
```kconfig
config BR2_PACKAGE_KMOD
	bool "kmod"
	help
	  handle kernel modules

	  https://git.kernel.org/pub/scm/utils/kernel/kmod/kmod.git

if BR2_PACKAGE_KMOD

config BR2_PACKAGE_KMOD_TOOLS
	bool "kmod utilities"
	help
	  Install kmod module utilities (depmod, insmod, lsmod,
	  modinfo, modprobe, rmmod).

endif
```

## package/libcap/Config.in
```kconfig
config BR2_PACKAGE_LIBCAP
	bool "libcap"
	help
	 This library implements the user-space interfaces to the
	 POSIX 1003.1e capabilities available in Linux kernels. These
	 capabilities are a partitioning of the all powerful root
	 privilege into a set of distinct privileges.

	 https://sites.google.com/site/fullycapable/

	 https://git.kernel.org/pub/scm/libs/libcap/libcap.git/
```

## package/libedit/Config.in
```kconfig
config BR2_PACKAGE_LIBEDIT
	bool "libedit"
	select BR2_PACKAGE_NCURSES
	help
	  The editline library (from BSD) provides generic line editing
	  and history functions. It slightly resembles GNU readline.

	  Jess Thrysoee maintains an autotoolified package, which we use
	  in Buildroot as it makes it much simpler than using the upstream
	  sources which require pmake.

	  http://www.thrysoee.dk/editline
```

## package/libfb/Config.in
```kconfig
config BR2_PACKAGE_LIBFB
	bool "libfb"
 	default n
	select BR2_PACKAGE_LIBNET
	help
	  Flash Block Library needed for the RedFone fonulator software
	  	  
	  http://support.red-fone.com/downloads/fonulator/
```

## package/libfuse/Config.in
```kconfig
config BR2_PACKAGE_LIBFUSE
	bool "libfuse"
	depends on BR2_TOOLCHAIN_HAS_THREADS
	depends on BR2_USE_MMU # fork()
	help
	  FUSE (Filesystem in UserSpacE)

	  https://github.com/libfuse/libfuse
```

## package/libnet/Config.in
```kconfig
config BR2_PACKAGE_LIBNET
	bool "libnet"
 	default n
	select BR2_PACKAGE_LIBPCAP
	help
	  libnet provides a portable framework for low-level network packet
	  construction. libnet at packetfactory is dead, no response to email, and
	  no bug fixing. This version is being maintained at:
	  
	  http://github.com/sam-github/libnet
```

## package/libpri/Config.in
```kconfig
config BR2_PACKAGE_LIBPRI
        bool "Asterisk PRI Support"
        default n
        depends on BR2_PACKAGE_ASTERISK
        help
          Compile Asterisk with PRI support - only useful with DAHDI
```

## package/libretls/Config.in
```kconfig
config BR2_PACKAGE_LIBRETLS
	bool "libretls"
	select BR2_PACKAGE_OPENSSL
	help
	  LibreTLS is a port of libtls from LibreSSL to OpenSSL.
	  libtls is a new TLS library, designed to make it easier to write foolproof applications.

	  https://git.causal.agency/libretls/about/
```

## package/libsodium/Config.in
```kconfig
config BR2_PACKAGE_LIBSODIUM
	bool "libsodium"
	default n
	help
	  Sodium is a portable, cross-compilable, installable, packageable
	  fork of the NaCl Cryptograpy & Networking library, with a compatible API.

	  http://github.com/jedisct1/libsodium
```

## package/libzip/Config.in
```kconfig
config BR2_PACKAGE_LIBZIP
	bool "libzip"
	select BR2_PACKAGE_ZLIB
	help
	  C library for reading, creating, and modifying zip archives.
	  This package also contains zipcmp, ziptool and zipmerge
	  utilities.

	  https://libzip.org/
```

## package/linux-atm/Config.in
```kconfig
config BR2_PACKAGE_LINUX_ATM
	bool "linux-atm"
	default n
	help
	  A collection of utilities for Linux to deal with ATM
	  connections. This also includes support for RFC2684
	  bridging.

	  http://sourceforge.net/projects/linux-atm/
```

## package/linux-firmware/Config.in
```kconfig
config BR2_PACKAGE_LINUX_FIRMWARE
	bool "linux-firmware"
	depends on BR2_LINUX_KERNEL
	default n
	help
	  This package provides various binary firmware files (closed
	  binary blobs) for such devices like LAN, WLAN cards etc.

	  https://git.kernel.org/pub/scm/linux/kernel/git/firmware/linux-firmware.git
```

## package/lua/Config.in
```kconfig
config BR2_PACKAGE_LUA
	bool "lua"
	help
	  Lua is a powerful, fast, light-weight, embeddable scripting language.

	  http://www.lua.org/
```

## package/luabitop/Config.in
```kconfig
config BR2_PACKAGE_LUABITOP
	bool "luabitop"
	help
	  Lua BitOp is a C extension module for Lua 5.1
	  which adds bitwise operations on numbers.

	  https://bitop.luajit.org/
```

## package/luasec/Config.in
```kconfig
config BR2_PACKAGE_LUASEC
	bool "luasec"
	help
	  LuaSec is a binding for OpenSSL library to provide TLS/SSL communication.

	  https://github.com/brunoos/luasec/wiki
```

## package/lxc/Config.in
```kconfig
config BR2_PACKAGE_LXC
	bool "lxc"
	depends on BR2_TOOLCHAIN_HAS_THREADS
	depends on BR2_USE_MMU # fork()
	help
	  Linux Containers (LXC), provides the ability to group and
	  isolate of a set of processes in a jail by virtualizing and
	  accounting the kernel resources. It is similar to
	  Linux-Vserver or Openvz.

	  https://linuxcontainers.org/

comment "lxc needs a glibc or musl toolchain w/ threads"
	depends on !BR2_TOOLCHAIN_HAS_THREADS
```

## package/mac2vendor/Config.in
```kconfig
config BR2_PACKAGE_MAC2VENDOR
	bool "mac2vendor"
	default n
	help
	  ORGANIZATIONALLY UNIQUE IDENTIFIER (OUI) OR 'COMPANY_ID'
	  Script and suporting database to lookup the vendor
	  public listing from an ethernet MAC address.

	  http://standards.ieee.org/develop/regauth/oui/public.html
```

## package/mdnsresponder/Config.in
```kconfig
config BR2_PACKAGE_MDNSRESPONDER
	depends on !BR2_PACKAGE_AVAHI
	bool "mdnsresponder"
	default n
	help
		mDNSresponder - Multi platform service discovery

		http://developer.apple.com/opensource/internet/bonjour.html
```

## package/memtest/Config.in
```kconfig
config BR2_PACKAGE_MEMTEST
	bool "memtest"
	default n
	help
	  Memory diagnostics for X86 machines.

	  http://www.memtest.org
```
