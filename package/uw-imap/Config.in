## package/uw-imap/Config.in
```kconfig
config BR2_PACKAGE_UW_IMAP
        bool "uw-imap"
        default n
        help
	    
	IMAP (Internet Message Access Protocol) (client for Asterisk only)
	  http://www.washington.edu/imap/
```

## package/wanpipe/Config.in
```kconfig
config BR2_PACKAGE_WANPIPE
	bool "wanpipe"
	select BR2_PACKAGE_DAHDI_LINUX
	select BR2_PACKAGE_FLEX
	depends on BR2_LINUX_KERNEL
	default n
	help
		Wanpipe - Support for Sangoma cards

		http://www.sangoma.com
```

## package/webinterface/Config.in
```kconfig
config BR2_PACKAGE_WEBINTERFACE
	bool "webinterface"
	default n
	depends on BR2_PACKAGE_LIGHTTPD
	help
		Pick a web interface for Astlinux
choice
        prompt "Interface Version"
        depends on BR2_PACKAGE_WEBINTERFACE
        default BR2_PACKAGE_WEBINTERFACE_v2
        help
                Select which version series to compile and install.

        config BR2_PACKAGE_WEBINTERFACE_v1
                bool "Original Astlinux Interface"
                help
                        Select this to install the original
                        web interface.
        config BR2_PACKAGE_WEBINTERFACE_v2
                bool "Lonnie's Alternative Interface"
                help
                        Select this to install the new interface that Lonnie
                        developed.
endchoice
```

## package/whois/Config.in
```kconfig
config BR2_PACKAGE_WHOIS
	bool "whois"
	depends on BR2_USE_WCHAR # gettext
	help
	  Improved whois client.

	  https://github.com/rfc1036/whois
```

## package/wide-dhcpv6/Config.in
```kconfig
config BR2_PACKAGE_WIDE_DHCPV6
	bool "wide-dhcpv6"
	select BR2_PACKAGE_FLEX
	help
	  WIDE-DHCPv6 is an open-source implementation of Dynamic Host Configuration Protocol
	  for IPv6 (DHCPv6) originally developed by the KAME project.

	  This package installs the client component.

	  http://sourceforge.net/projects/wide-dhcpv6/

	  Debian Patches:
	  http://git.famille-corbier.net/?p=packages/wide-dhcpv6.git;a=summary
	  http://http.debian.net/debian/pool/main/w/wide-dhcpv6/wide-dhcpv6_20080615-13.debian.tar.xz
```

## package/wireguard-tools/Config.in
```kconfig
config BR2_PACKAGE_WIREGUARD_TOOLS
	bool "wireguard-tools"
	help
	  This supplies the main userspace tooling for using and
	  configuring WireGuard tunnels, including the wg(8) utility.

	  https://www.wireguard.com
```

## package/wireguard/Config.in
```kconfig
config BR2_PACKAGE_WIREGUARD
	bool "wireguard"
	depends on BR2_DEPRECATED
	depends on BR2_LINUX_KERNEL
	help
	  WireGuard is an extremely simple yet fast and modern VPN
	  that utilizes state-of-the-art cryptography. It aims to be
	  faster, simpler, leaner, and more useful than IPSec, while
	  avoiding the massive headache. It intends to be considerably
	  more performant than OpenVPN. WireGuard is designed as a
	  general purpose VPN for running on embedded interfaces and
	  super computers alike, fit for many different circumstances.

	  Backports of the WireGuard kernel module for
	  Linux to 3.10 <= kernel <= 5.5.y, as an out-of-tree module.

	  https://www.wireguard.com
```

## package/zabbix/Config.in
```kconfig
config BR2_PACKAGE_ZABBIX
	bool "zabbix"
	default n
	help
	  Zabbix agent to be used with Zabbix Monitoring Solution

	  http://www.zabbix.com	

config BR2_PACKAGE_ZABBIX_PROXY
	bool "zabbix_proxy"
	default n
	depends on BR2_PACKAGE_ZABBIX
	select BR2_PACKAGE_SQLITE
	help
	  Zabbix proxy to be used with Zabbix Monitoring Solution

	  http://www.zabbix.com
```

## package/zlib/Config.in
```kconfig
config BR2_PACKAGE_ZLIB
	bool "zlib"
	help
	  Standard (de)compression library.  Used by things like
	  gzip and libpng.

	  https://zlib.net/
```

## package/zoneinfo/Config.in
```kconfig
config BR2_PACKAGE_ZONEINFO
	bool "zoneinfo"
	default n
	help
	  Timezone Data files required by some glibc applications
	  to resolve localtime correctly.

	  ftp://elsie.nci.nih.gov/pub/ 
```
