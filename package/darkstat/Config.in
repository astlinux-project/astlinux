## package/darkstat/Config.in
```kconfig
config BR2_PACKAGE_DARKSTAT
	bool "darkstat"
 	default n
	select BR2_PACKAGE_LIBPCAP
	help
	  Darkstat:
	  Captures network traffic, calculates statistics about usage,
	  and serves reports over HTTP.
	  	  
	  https://github.com/emikulic/darkstat
```

## package/ddclient/Config.in
```kconfig
config BR2_PACKAGE_DDCLIENT
	bool "ddclient"
	select BR2_PACKAGE_PERL
	select BR2_PACKAGE_LIBCURL
	select BR2_PACKAGE_CURL
	default n
	help
	  DDclient is a Perl client used to update dynamic DNS entries for
	  accounts on a Dynamic DNS Network Service Provider.

	  https://github.com/astlinux-project/ddclient-curl
```

## package/dibbler/Config.in
```kconfig
config BR2_PACKAGE_DIBBLER
	bool "dibbler"
	help
	  Dibbler is a portable DHCPv6 implementation.

	  http://klub.com.pl/dhcpv6/
	  http://sourceforge.net/projects/dibbler/
```

## package/dnscrypt-proxy/Config.in
```kconfig
config BR2_PACKAGE_DNSCRYPT_PROXY
	bool "dnscrypt-proxy"
	select BR2_PACKAGE_LIBSODIUM
	default n
	help
	  dnscrypt-proxy is a slight variation on DNSCurve.
	  DNSCurve improves the confidentiality and integrity of DNS requests using 
	  high-speed high-security elliptic-curve cryptography. Best of all, DNSCurve 
	  has very low overhead and adds virtually no latency to queries.

	  http://dnscrypt.org/
```

## package/e1000/Config.in
```kconfig
config BR2_PACKAGE_E1000
	bool "e1000"
	depends on BR2_LINUX_KERNEL
	default n
	help
	  Newer stable e1000 Intel PRO/1000 Linux driver

	  http://sourceforge.net/projects/e1000/
```

## package/e1000e/Config.in
```kconfig
config BR2_PACKAGE_E1000E
	bool "e1000e"
	depends on BR2_DEPRECATED
	depends on BR2_LINUX_KERNEL
	default n
	help
	  Newer stable e1000e Intel PRO/1000 Linux driver

	  http://sourceforge.net/projects/e1000/
```

## package/e2fsprogs/Config.in
```kconfig
config BR2_PACKAGE_E2FSPROGS
	bool "e2fsprogs"
	depends on BR2_LARGEFILE
	select BR2_PACKAGE_UTIL_LINUX
	select BR2_PACKAGE_UTIL_LINUX_LIBBLKID
	select BR2_PACKAGE_UTIL_LINUX_LIBUUID
	help
	  The EXT2 file system utilities.

	  http://e2fsprogs.sf.net

if BR2_PACKAGE_E2FSPROGS

config BR2_PACKAGE_E2FSPROGS_BADBLOCKS
	bool "badblocks"
	default y

config BR2_PACKAGE_E2FSPROGS_CHATTR
	bool "chattr"
	default y

config BR2_PACKAGE_E2FSPROGS_DEBUGFS
	bool "debugfs"

config BR2_PACKAGE_E2FSPROGS_DUMPE2FS
	bool "dumpe2fs"
	default y

config BR2_PACKAGE_E2FSPROGS_E2FREEFRAG
	bool "e2freefrag"
	default y

config BR2_PACKAGE_E2FSPROGS_E2FSCK
	bool "e2fsck"
	default y

config BR2_PACKAGE_E2FSPROGS_E2IMAGE
	bool "e2image"

config BR2_PACKAGE_E2FSPROGS_E2LABEL
	bool "e2label"
	select BR2_PACKAGE_E2FSPROGS_TUNE2FS
	default y

config BR2_PACKAGE_E2FSPROGS_E2UNDO
	bool "e2undo"
	default y

config BR2_PACKAGE_E2FSPROGS_FILEFRAG
	bool "filefrag"
	default y

config BR2_PACKAGE_E2FSPROGS_FSCK
	bool "fsck"
	default y

config BR2_PACKAGE_E2FSPROGS_LOGSAVE
	bool "logsave"
	default y

config BR2_PACKAGE_E2FSPROGS_LSATTR
	bool "lsattr"
	default y

config BR2_PACKAGE_E2FSPROGS_MKE2FS
	bool "mke2fs"
	default y

config BR2_PACKAGE_E2FSPROGS_MKLOSTFOUND
	bool "mklost+found"
	default y

config BR2_PACKAGE_E2FSPROGS_RESIZE2FS
	bool "resize2fs"

config BR2_PACKAGE_E2FSPROGS_TUNE2FS
	bool "tune2fs"
	default y

endif
```

## package/ex-vi/Config.in
```kconfig
config BR2_PACKAGE_EX_VI
	bool "ex-vi"
	select BR2_PACKAGE_NCURSES
	help
	  ex-vi Text editor

	  https://ex-vi.sourceforge.net/

	  https://github.com/n-t-roff/heirloom-ex-vi
```

## package/fbflash/Config.in
```kconfig
config BR2_PACKAGE_FBFLASH
	bool "fbflash"
 	default n
	depends on BR2_PACKAGE_FONULATOR
	select BR2_PACKAGE_LIBFB
	help
	  RedFone fbflash FoneBRIDGE2 configuration software
	  	  
	  http://support.red-fone.com/fb_flash/
```

## package/flashrom/Config.in
```kconfig
config BR2_PACKAGE_FLASHROM
	bool "flashrom"
	select BR2_PACKAGE_PCIUTILS
	select BR2_PACKAGE_LIBUSB
	select BR2_PACKAGE_LIBUSB_COMPAT
	depends on BR2_i386 || BR2_x86_64
	help
	  flashrom is a utility for identifying, reading, writing,
	  verifying and erasing flash chips. It is designed to flash
	  BIOS/EFI/coreboot/firmware/optionROM images on mainboards,
	  network/graphics/storage controller cards, and various other
	  programmer devices.

	  https://flashrom.org/
```

## package/flex/Config.in
```kconfig
config BR2_PACKAGE_FLEX
	bool "flex"
	help
	  A fast lexical analyser generator.  A tool for generating
	  programs that perform pattern-matching on text.

	  http://flex.sourceforge.net/
```

## package/fonulator/Config.in
```kconfig
config BR2_PACKAGE_FONULATOR
	bool "fonebridge-fonulator"
 	default n
	select BR2_PACKAGE_LIBARGTABLE2
	select BR2_PACKAGE_LIBFB
	select BR2_PACKAGE_FBFLASH
	help
	  RedFone fonulator FoneBRIDGE2 configuration software
	  	  
	  http://support.red-fone.com/downloads/fonulator/
```

## package/fossil/Config.in
```kconfig
config BR2_PACKAGE_FOSSIL
	bool "fossil"
	select BR2_PACKAGE_OPENSSL
	select BR2_PACKAGE_ZLIB
	help
	  Fossil is a simple, high-reliability, distributed software
	  configuration management system.

	  http://www.fossil-scm.org/
```

## package/fping/Config.in
```kconfig
config BR2_PACKAGE_FPING
	bool "fping"
	default n
	help
	  fping is a program to send ICMP echo probes to network hosts, similar to ping,
	  but much better performing when pinging multiple hosts. fping has a very
	  long history: Roland Schemers did publish a first version of it in 1992 and it has
	  established itself since then as a standard tool for network diagnostics and statistics.

	  http://fping.org/
```

## package/freeswitch/Config.in
```kconfig
config BR2_PACKAGE_FREESWITCH
	bool "freeswitch"
	default n
	select BR2_PACKAGE_OPENSSL
	select BR2_PACKAGE_ZLIB
	select BR2_PACKAGE_LIBPCAP
	help
	  Open source telephony platform

	  http://www.freeswitch.org/

config BR2_PACKAGE_FREESWITCH_SOUNDS
	bool "freeswitch sounds"
	default n
	depends on BR2_PACKAGE_FREESWITCH
	help
	  Install FreeSWITCH sounds and MOH
```

## package/fxload/Config.in
```kconfig
config BR2_PACKAGE_FXLOAD
	bool "fxload"
	default n
	help
	  fxload is used to load firmware over usb
	  specifically, we use it with Xorcom hardware

	  http://sourceforge.net/projects/linux-hotplug
```

## package/getdns/Config.in
```kconfig
config BR2_PACKAGE_GETDNS
	bool "getdns/stubby"
	depends on BR2_DEPRECATED
	select BR2_PACKAGE_OPENSSL
	select BR2_PACKAGE_LIBIDN
	select BR2_PACKAGE_LIBYAML
	help
	  getdns is a modern asynchronous DNS API.
	  It implements DNS entry points from a design developed and
	  vetted by application developers, in an API specification.

	  Stubby is an implementation of a DNS Privacy enabled stub resolver.

	  https://getdnsapi.net/
```

## package/gntp-send/Config.in
```kconfig
config BR2_PACKAGE_GNTP_SEND
	bool "gntp-send"
	default n
	help
	  A command line tool for sending notifications to Growl.
	  A library for integrating Growl into you C or C++ based applications.

	  https://github.com/mattn/gntp-send
```

## package/gnu-efi/Config.in
```kconfig
config BR2_PACKAGE_GNU_EFI
	bool "gnu-efi"
	help
	  Develop EFI applications for ARM-64, ARM-32, x86_64, IA-64
	  (IPF), IA-32 (x86), and MIPS platforms using the GNU toolchain
	  and the EFI development environment.

	  https://sourceforge.net/projects/gnu-efi/
```

## package/gob2/Config.in
```kconfig
config BR2_PACKAGE_GOB2
	bool "gob2"
	help
	  GOB (GTK+ Object Builder) is a preprocessor which simplifies
	  the writing of GObjects in C.

	  http://www.jirka.org/gob.html

	  **HOST Only**
```

## package/htop/Config.in
```kconfig
config BR2_PACKAGE_HTOP
	bool "htop"
	select BR2_PACKAGE_NCURSES
	help
	  htop is a cross-platform interactive process viewer.
	  It is a text-mode application (for console or X terminals)
	  and requires ncurses.

	  https://htop.dev/
	  https://github.com/htop-dev/htop/releases
```

## package/htpasswd/Config.in
```kconfig
config BR2_PACKAGE_HTPASSWD
	bool "htpasswd"
	default n
	help
	  htpasswd command from mini_httpd
	  Note: Used in asterisk ast-vmpass script

	  http://www.acme.com/software/mini_httpd/
```

## package/iftop/Config.in
```kconfig
config BR2_PACKAGE_IFTOP
	bool "iftop"
	default n
	select BR2_PACKAGE_LIBPCAP
	select BR2_PACKAGE_NCURSES
	help
	  iftop does for network usage what top(1) does for CPU usage. 
	  It listens to network traffic on a named interface and displays 
	  a table of current bandwidth usage by pairs of hosts. Handy for 
	  answering the question "why is our ADSL link so slow?".

	  http://www.ex-parrot.com/~pdw/iftop/
```

## package/igb/Config.in
```kconfig
config BR2_PACKAGE_IGB
	bool "igb"
	depends on BR2_DEPRECATED
	depends on BR2_LINUX_KERNEL
	default n
	help
	  Newer stable igb Intel Gigabit Ethernet Network Driver

	  http://sourceforge.net/projects/e1000/
```

## package/iksemel/Config.in
```kconfig
config BR2_PACKAGE_IKSEMEL
	bool "iksemel"
	default n
	help
	  iksemel is an XML (eXtensible Markup Language) parser library
	  designed for Jabber applications.

	  https://github.com/meduketto/iksemel
```
