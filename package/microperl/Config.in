## package/microperl/Config.in
```kconfig
config BR2_PACKAGE_MICROPERL
	depends on !BR2_PACKAGE_PERL
	bool "microperl"
	help
	  Perl without operating-specific functions such as readdir.
```

## package/miniupnpd/Config.in
```kconfig
config BR2_PACKAGE_MINIUPNPD
	bool "miniupnpd"
	depends on BR2_LINUX_KERNEL
	select BR2_PACKAGE_IPTABLES
	select BR2_PACKAGE_UTIL_LINUX
	select BR2_PACKAGE_UTIL_LINUX_LIBUUID
	help
	  Implements UPnP and NAT-PMP/PCP protocols.

	  http://miniupnp.free.fr/
```

## package/misdn-digium/Config.in
```kconfig
config BR2_PACKAGE_MISDN_DIGIUM
        bool "misdn-digium"
        default n
	select BR2_PACKAGE_BC
	select BR2_PACKAGE_USBUTILS
	select BR2_PACKAGE_PCIUTILS
        help
                mISDN drivers v1.x in Digium's Thirdparty Repo

                http://svn.digium.com/svn/thirdparty/mISDN/
		http://svn.digium.com/svn/thirdparty/mISDNuser/
```

## package/msmtp/Config.in
```kconfig
config BR2_PACKAGE_MSMTP
	bool "msmtp"
	select BR2_PACKAGE_LIBRETLS
	default n
	help
	  msmtp is an MUA/MTa like ssmtp, only better

	  https://marlam.de/msmtp/
```

## package/mtr/Config.in
```kconfig
config BR2_PACKAGE_MTR
	bool "mtr"
 	default n
	select BR2_PACKAGE_NCURSES
	select BR2_PACKAGE_LIBCAP
	help
	  My TraceRoute
	  mtr combines the functionality of the 'traceroute' and 'ping'
	  programs in a single network diagnostic tool.
	  	  
	  https://github.com/traviscross/mtr
```

## package/multimedia/beep/Config.in
```kconfig
config BR2_PACKAGE_BEEP
	bool "beep"
	default n
	help
	  beep allows the user to have the PC speaker issue beeps and beep patterns
	  with given frequencies, durations, and spacing on Linux systems.

	  https://github.com/spkr-beep/beep
```

## package/multimedia/sox/Config.in
```kconfig
config BR2_PACKAGE_SOX
	bool "sox"
	default n
	help
		SoX - The Swiss Army Knife of sound

config BR2_PACKAGE_SOX_LIBMAD
        bool "SoX MP3 Decode Support"
        default n
        depends on BR2_PACKAGE_SOX
	select BR2_PACKAGE_LIBMAD
        help
          Compile SoX with MP3 decoding support via libmad
```

## package/ne/Config.in
```kconfig
config BR2_PACKAGE_NE
	bool "ne"
	select BR2_PACKAGE_NCURSES
	help
	  ne, the nice editor

	  http://ne.di.unimi.it/
```

## package/netcalc/Config.in
```kconfig
config BR2_PACKAGE_NETCALC
	bool "netcalc"
	help
	  netcalc is a slimmed down clone of sipcalc, using the output
	  format of ipcalc. It is written in C and has very few dependencies.
	  Both IPv4 and IPv6 is supported.

	  https://github.com/troglobit/netcalc
```

## package/ngrep/Config.in
```kconfig
config BR2_PACKAGE_NGREP
	bool "ngrep"
	default n
	select BR2_PACKAGE_LIBPCAP
	select BR2_PACKAGE_PCRE2
	help
	  Network grep.

	  https://github.com/jpr5/ngrep/
```

## package/nmap/Config.in
```kconfig
config BR2_PACKAGE_NMAP
	bool "nmap"
	default n
	select BR2_PACKAGE_LIBPCAP
	select BR2_PACKAGE_OPENSSL
	help
	  THE security scanner

	  http://nmap.org/

config BR2_PACKAGE_NMAP_DB
	depends on BR2_PACKAGE_NMAP
	bool "nmap-db"
	default "n"
	help
	  Various "DBs" for nmap:
	  - OS Detection
	  - OUI lookup table for MAC vendor detection
```

## package/nut/Config.in
```kconfig
config BR2_PACKAGE_NUT
	bool "nut"
	help
	  Network UPS tools

	  The primary goal of the Network UPS Tools (NUT) project is to provide
	  support for Power Devices, such as Uninterruptible Power Supplies,
	  Power Distribution Units and Solar Controllers.

	  http://www.networkupstools.org/

if BR2_PACKAGE_NUT

config BR2_PACKAGE_NUT_SERIAL_DRIVERS
	bool "serial drivers"
	help
	  Select to enable the building of serial drivers.

endif # BR2_PACKAGE_NUT
```

## package/openldap/Config.in
```kconfig
config BR2_PACKAGE_OPENLDAP
	bool "openldap"
	select BR2_PACKAGE_OPENSSL
	help
	  OpenLDAP Software is an open source implementation of the
	  Lightweight Directory Access Protocol.

	  The suite includes:
	  - slapd: stand-alone LDAP daemon (optional server)
	  - libraries: implementing the LDAP protocol
	  - utilities, tools, and sample clients (ex. ldapsearch)

	  http://www.openldap.org/

config BR2_PACKAGE_OPENLDAP_SERVER
	bool "openldap-server"
	default n
	depends on BR2_PACKAGE_OPENLDAP
	help
	  Include slapd and server related files.
```

## package/opensips/Config.in
```kconfig
config BR2_PACKAGE_OPENSIPS
	bool "opensips"
	default n
	select BR2_PACKAGE_OPENSSL
	help
	  OpenSIPS is a mature and flexible open source SIP server (RFC3261).

	  http://www.opensips.org
```

## package/openssl/Config.in
```kconfig
config BR2_PACKAGE_OPENSSL
	bool "openssl"
	select BR2_PACKAGE_ZLIB
	help
	  A collaborative effort to develop a robust, commercial-grade, fully
	  featured, and Open Source toolkit implementing the Secure Sockets
	  Layer (SSL v2/v3) and Transport Security (TLS v1) as well as a
	  full-strength general-purpose cryptography library.

	  https://www.openssl.org/

if BR2_PACKAGE_OPENSSL

config BR2_PACKAGE_OPENSSL_BIN
	bool "openssl binary"
	help
	  Install the openssl binary to the target file system. This is a
	  command line tool for doing various crypthographic stuff.

config BR2_PACKAGE_OPENSSL_ENGINES
	bool "openssl additional engines"
	help
	  Install additional encryption engine libraries.

config BR2_PACKAGE_OPENSSL_OCF
	bool "openssl ocf support"
	help
	  Enable openssl cryptodev (OCF) hardware acceleration support.
	  This requires kernel patches from the ocf-linux project otherwise
	  you'll just have a bigger openssl library that works as usual.
	  Note:  This needs to be moved to a separate package to work
	         as per upstream Buildroot using package "ocf-linux".

	  http://ocf-linux.sourceforge.net/

endif
```

## package/p910nd/Config.in
```kconfig
config BR2_PACKAGE_P910ND
	bool "p910nd"
	default n
	help
	  p910nd is a small printer daemon intended for diskless workstations
	  that does not spool to disk but passes the job directly to the
	  printer.

	  http://www.etherboot.org/p910nd
```

## package/pciutils/Config.in
```kconfig
config BR2_PACKAGE_PCIUTILS
	bool "pciutils"
	depends on BR2_LINUX_KERNEL
	help
	  Various utilities dealing with the PCI bus.
	  Provides things like setpci and lspci.

	  You'll need a copy of pci.ids or pci.ids.gz in your
	  target skeleton to enjoy verbose output.

	  http://atrey.karlin.mff.cuni.cz/~mj/pciutils.html
```

## package/pcre2/Config.in
```kconfig
config BR2_PACKAGE_PCRE2
	bool "pcre2"
	help
	  PCRE2 library, Perl Compatible Regular Expressions

	  https://github.com/PCRE2Project/pcre2
```

## package/perl/Config.in
```kconfig
config BR2_PACKAGE_PERL
	bool "perl"
	depends on BR2_LINUX_KERNEL
	default n
	help
	  Larry Wall's Practical Extraction and Report Language
	  An interpreted scripting language, known among some as "Unix's Swiss
	  Army Chainsaw".

	Perl:
	  http://www.perl.org/

	Perl-Cross:
	  http://arsv.github.io/perl-cross/
```

## package/phoneprov-tools/Config.in
```kconfig
config BR2_PACKAGE_PHONEPROV_TOOLS
	bool "phoneprov-tools"
	depends on BR2_PACKAGE_ASTERISK
	default n
	help
	  A set of scripts and configuration templates designed to
	  generate IP Phone provisioning files as well as Asterisk
	  sip.conf and extensions.conf includes files.

	  Lonnie Abelbeck and Michael Keuter
	  https://www.astlinux-project.org/
```

## package/php/Config.in
```kconfig
config BR2_PACKAGE_PHP
	bool "php"
	help
	  PHP  is a widely-used general-purpose scripting
	  language that is especially suited for Web development
	  and can be embedded into HTML.

	  http://www.php.net

if BR2_PACKAGE_PHP

config BR2_PACKAGE_PHP_CLI
	bool

config BR2_PACKAGE_PHP_CGI
	bool

config BR2_PACKAGE_PHP_FPM
	bool

choice
	prompt "PHP interface"
	default BR2_PACKAGE_PHP_SAPI_CGI
	help
	  Select the PHP interface(s).

config BR2_PACKAGE_PHP_SAPI_CGI
	bool "cgi interface"
	select BR2_PACKAGE_PHP_CGI
	help
	  Common Gateway Interface

config BR2_PACKAGE_PHP_SAPI_CLI
	bool "cli interface"
	select BR2_PACKAGE_PHP_CLI
	help
	  Command Line Interface

config BR2_PACKAGE_PHP_SAPI_FPM
	bool "fpm interface"
	select BR2_PACKAGE_PHP_FPM
	help
	  PHP-FPM (FastCGI Process Manager)

config BR2_PACKAGE_PHP_SAPI_CLI_CGI
	bool "cli and cgi interfaces"
	select BR2_PACKAGE_PHP_CLI
	select BR2_PACKAGE_PHP_CGI
	help
	  Command line and Common gateway interfaces

config BR2_PACKAGE_PHP_SAPI_CLI_FPM
	bool "cli and fpm interfaces"
	select BR2_PACKAGE_PHP_CLI
	select BR2_PACKAGE_PHP_FPM
	help
	  Command line and PHP-FPM (FastCGI Process Manager)

endchoice

source "package/php/Config.ext"
endif
```

## package/pjsip-ast20/Config.in
```kconfig
config BR2_PACKAGE_PJSIP_AST20
	bool "pjsip-ast20"
	help
	  PJSIP is a free and open source multimedia communication library
	  written in C language implementing standard based protocols such as:
	    SIP, SDP, RTP, STUN, TURN, and ICE.
	  (For Asterisk 20.x)

	  https://www.pjsip.org
	  https://github.com/pjsip/pjproject
```

## package/pjsip/Config.in
```kconfig
config BR2_PACKAGE_PJSIP
	bool "pjsip"
	help
	  PJSIP is a free and open source multimedia communication library
	  written in C language implementing standard based protocols such as:
	    SIP, SDP, RTP, STUN, TURN, and ICE.

	  http://www.pjsip.org
```

## package/pppd/Config.in
```kconfig
config BR2_PACKAGE_PPPD
	select BR2_PACKAGE_OPENSSL
	select BR2_PACKAGE_LIBPCAP
	bool "pppd"
	help
	  An implementation of the Point-to-point protocol.

	  https://github.com/paulusmack/ppp
```

## package/pptpd/Config.in
```kconfig
config BR2_PACKAGE_PPTPD
	bool "pptpd"
	default n
	select BR2_PACKAGE_PPPD
	help
	    poptop PPTP daemon
```
